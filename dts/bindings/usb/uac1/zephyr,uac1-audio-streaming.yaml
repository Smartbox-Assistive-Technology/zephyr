## dts/bindings/usb/uac1/zephyr,uac1-audio-streaming.yaml
```yaml
# Copyright (c) 2025 Smartbox Assistive Technology Ltd
# SPDX-License-Identifier: Apache-2.0

description: USB Audio Class 1 Audio Streaming interface

compatible: "zephyr,uac1-audio-streaming"

properties:
  linked-terminal:
    type: phandle
    required: true
    description: |
      Input or Output Terminal to which this interface is connected.

  implicit-feedback:
    type: boolean
    description: |
      Enable implicit feedback on asynchronous endpoint. For OUT endpoints
      setting this property removes explicit feedback endpoint.

  subframe-size:
    type: int
    required: true
    description: |
      Number of bytes occupied by one audio subframe (per channel).
      Can be 1, 2, 3 or 4.

  bit-resolution:
    type: int
    required: true
    description: |
      Number of effectively used bits in audio subframe.

  sampling-frequencies:
    type: array
    required: true
    description: |
      List of supported sampling frequencies in Hz. Values must be sorted
      in ascending order. Each value is encoded as 3 bytes in the descriptor.
```

## dts/bindings/usb/uac1/zephyr,uac1-channel-cluster.yaml
```yaml
# Copyright (c) 2025 Smartbox Assistive Technology Ltd
# SPDX-License-Identifier: Apache-2.0

description: USB Audio Class 1 Audio Channel Cluster

properties:
  front-left:
    type: boolean
    description: Front Left channel present in the cluster

  front-right:
    type: boolean
    description: Front Right channel present in the cluster

  front-center:
    type: boolean
    description: Front Center channel present in the cluster

  low-frequency-effects:
    type: boolean
    description: Low Frequency Effects channel present in the cluster

  back-left:
    type: boolean
    description: Back Left channel present in the cluster

  back-right:
    type: boolean
    description: Back Right channel present in the cluster

  front-left-of-center:
    type: boolean
    description: Front Left of Center channel present in the cluster

  front-right-of-center:
    type: boolean
    description: Front Right of Center channel present in the cluster

  back-center:
    type: boolean
    description: Back Center channel present in the cluster

  side-left:
    type: boolean
    description: Side Left channel present in the cluster

  side-right:
    type: boolean
    description: Side Right channel present in the cluster
```

## dts/bindings/usb/uac1/zephyr,uac1.yaml
```yaml
# Copyright (c) 2025 Smartbox Assistive Technology Ltd
# SPDX-License-Identifier: Apache-2.0

description: USB Audio Class 1 instance

compatible: "zephyr,uac1"

properties:
  full-speed:
    type: boolean
    description: |
      True if this instance is allowed to operate at Full-Speed.
```

## subsys/usb/device_next/class/Kconfig.uac1
```kconfig
# Copyright (c) 2025 Smartbox Assistive Technology Ltd
#
# SPDX-License-Identifier: Apache-2.0

config USBD_AUDIO1_CLASS
	bool "USB Audio 1 class support"
	select UDC_ENABLE_SOF
	help
	  USB Audio 1 device class support for the device_next USB stack.

if USBD_AUDIO1_CLASS

module = USBD_UAC1
module-str = usbd uac1
source "subsys/logging/Kconfig.template.log_config"

endif
```
